// ═══════════════════════════════════════════════════════════════════════════
// TFM TinyML Detector — main.cpp
//
// Entry point for the ESP32-S3 TinyML object detection firmware.
// Orchestrates: camera → preprocess → inference → postprocess → metrics → WS
//
// Architecture:
//   Core 0 — Inference task  (capture + infer + postprocess)
//   Core 1 — WiFi + HTTP/WS  (managed by ESP-IDF)
//
// Model selection at compile time via ACTIVE_MODEL_TYPE / ACTIVE_ENGINE_TYPE
// or at runtime via WebSocket command.
// ═══════════════════════════════════════════════════════════════════════════
#include "app_config.h"
#include "camera.h"
#include "image_proc.h"
#include "inference_engine.h"
#include "tflite_engine.h"
#include "espdl_engine.h"
#include "postprocess.h"
#include "metrics.h"
#include "wifi_manager.h"
#include "web_server.h"
#include "stream_buf.h"

#include "img_converters.h"    // frame2jpg() from esp32-camera

#include "esp_log.h"
#include "esp_system.h"
#include "esp_heap_caps.h"
#include "esp_ipc.h"
#include "freertos/FreeRTOS.h"
#include "freertos/task.h"

#include <cstdio>
#include <memory>

static const char* TAG = "main";

struct EngineIpcCtx {
    InferenceEngine* engine;
    ModelConfig      cfg;
    esp_err_t        result;
};

static void ipc_engine_deinit(void* arg) {
    auto* ctx = static_cast<EngineIpcCtx*>(arg);
    if (!ctx || !ctx->engine) return;
    ctx->engine->deinit();
    ctx->result = ESP_OK;
}

static void ipc_engine_init(void* arg) {
    auto* ctx = static_cast<EngineIpcCtx*>(arg);
    if (!ctx || !ctx->engine) {
        if (ctx) ctx->result = ESP_ERR_INVALID_ARG;
        return;
    }
    ctx->result = ctx->engine->init(&ctx->cfg);
}

static esp_err_t engine_switch_via_ipc(InferenceEngine* engine,
                                       const ModelConfig& next_cfg,
                                       const ModelConfig& rollback_cfg)
{
    if (!engine) return ESP_ERR_INVALID_ARG;

    const int this_core = xPortGetCoreID();
    const int ipc_core  = (this_core == 0) ? 1 : 0;

    EngineIpcCtx deinit_ctx{ .engine = engine, .cfg = {}, .result = ESP_OK };
    esp_err_t ret = esp_ipc_call_blocking(ipc_core, ipc_engine_deinit, &deinit_ctx);
    if (ret != ESP_OK) {
        ESP_LOGE(TAG, "IPC deinit falló: %s", esp_err_to_name(ret));
        return ret;
    }

    EngineIpcCtx init_ctx{ .engine = engine, .cfg = next_cfg, .result = ESP_FAIL };
    ret = esp_ipc_call_blocking(ipc_core, ipc_engine_init, &init_ctx);
    if (ret != ESP_OK) {
        ESP_LOGE(TAG, "IPC init falló: %s", esp_err_to_name(ret));
        return ret;
    }

    if (init_ctx.result != ESP_OK) {
        EngineIpcCtx rollback_ctx{ .engine = engine, .cfg = rollback_cfg, .result = ESP_FAIL };
        esp_err_t rollback_ipc = esp_ipc_call_blocking(ipc_core, ipc_engine_init, &rollback_ctx);
        if (rollback_ipc != ESP_OK) {
            ESP_LOGE(TAG, "IPC rollback falló: %s", esp_err_to_name(rollback_ipc));
        } else if (rollback_ctx.result != ESP_OK) {
            ESP_LOGE(TAG, "Rollback init falló: %s", esp_err_to_name(rollback_ctx.result));
        }
    }

    return init_ctx.result;
}

// ─── Crop buffer (224×224 RGB565) para JPEG stream ────────────────────────
// Allocated once in PSRAM.  224 × 224 × 2 = 100 352 bytes
static uint8_t* s_crop_rgb565 = nullptr;

/// Extract center 224×224 crop from 320×240 RGB565 frame into s_crop_rgb565.
static void crop_224(const camera_fb_t* fb) {
    const uint16_t* src = reinterpret_cast<const uint16_t*>(fb->buf);
    uint16_t*       dst = reinterpret_cast<uint16_t*>(s_crop_rgb565);
    for (int y = 0; y < INPUT_HEIGHT; ++y) {
        const uint16_t* row = &src[(y + CROP_OFFSET_Y) * CAMERA_WIDTH + CROP_OFFSET_X];
        std::memcpy(&dst[y * INPUT_WIDTH], row, INPUT_WIDTH * sizeof(uint16_t));
    }
}

// ═══════════════════════════════════════════════════════════════════════════
//  Model data (TFLite C arrays — generated by xxd)
// ═══════════════════════════════════════════════════════════════════════════
#include "models/tflite/mobilenetv2_ssdlite_v1_int8.h"
#include "models/tflite/yolo11n_v1_int8.h"
#include "models/tflite/yolo26n_v1_int8.h"
#include "models/tflite/yolo26n_v1_fullint8.h"
#include "models/tflite/yolo11n_v1_fullint8.h"

// ─── ESP-DL models loaded from flash partitions ─────────────────────────
// No embedded binaries needed — models are mmap'd from dedicated partitions:
//   model_espdet → espdet_pico_t4.espdl (0xA10000, 1 MB)
//   model_yolo26 → yolo26n_t2_esp.espdl (0xB10000, 3 MB)
// Use scripts/flash_models.sh to flash model data independently.

// ═══════════════════════════════════════════════════════════════════════════
//  Compile-time model selection  (override via sdkconfig / menuconfig)
// ═══════════════════════════════════════════════════════════════════════════
#ifndef ACTIVE_MODEL_TYPE
#define ACTIVE_MODEL_TYPE   ModelType::ESPDET_PICO
#endif

#ifndef ACTIVE_ENGINE_TYPE
#define ACTIVE_ENGINE_TYPE  EngineType::ESP_DL
#endif

// ═══════════════════════════════════════════════════════════════════════
//  Available models for runtime switching
// ═══════════════════════════════════════════════════════════════════════
struct AvailableModel {
    ModelType  type;
    EngineType engine;
};

static constexpr AvailableModel AVAILABLE_MODELS[] = {
    { ModelType::ESPDET_PICO,    EngineType::ESP_DL },
    { ModelType::YOLO26N_T3_ESP, EngineType::ESP_DL },
};
static_assert(sizeof(AVAILABLE_MODELS)/sizeof(AVAILABLE_MODELS[0]) == NUM_AVAILABLE_MODELS,
              "AVAILABLE_MODELS size must match NUM_AVAILABLE_MODELS");

// ═══════════════════════════════════════════════════════════════════════════
//  Model configurations
// ═══════════════════════════════════════════════════════════════════════════
static ModelConfig make_model_config(ModelType type, EngineType engine) {
    ModelConfig cfg{};
    cfg.type   = type;
    cfg.engine = engine;

    switch (type) {
    case ModelType::MOBILENET_SSD:
        cfg.name         = "MBNTv2_ssdlite_v1";
        cfg.tflite_data  = mobilenetv2_ssdlite_v1_int8_data;
        cfg.tflite_size  = mobilenetv2_ssdlite_v1_int8_data_len;
        cfg.arena_size   = 1260680 * 3;   // ~3.6 MB
        cfg.conf_threshold = 0.30f;       // SSD needs slightly higher
        break;

    case ModelType::YOLO11N:
        cfg.name         = "YOLO11n_v1_fullint8";
        cfg.tflite_data  = yolo11n_v1_fullint8_data;
        cfg.tflite_size  = yolo11n_v1_fullint8_data_len;
        cfg.arena_size   = 2893824 * 3;   // ~8.3 MB
        break;

    case ModelType::YOLO26N:
        cfg.name         = "YOLO26n_v1_fullint8";
        cfg.tflite_data  = yolo26n_v1_fullint8_data;
        cfg.tflite_size  = yolo26n_v1_fullint8_data_len;
        cfg.arena_size   = 2768153 * 3;   // ~7.9 MB
        break;

    case ModelType::ESPDET_PICO:
        cfg.name            = "ESPDet_Pico_T4";
        cfg.engine          = EngineType::ESP_DL;
        cfg.espdl_partition = "model_espdet";     // partitions.csv label
        cfg.tflite_data     = nullptr;
        cfg.tflite_size     = 0;
        cfg.arena_size      = 0;
        cfg.conf_threshold  = ESPDET_CONF_THRESHOLD;
        cfg.iou_threshold   = ESPDET_IOU_THRESHOLD;
        break;

    case ModelType::YOLO26N_ESP:
        cfg.name            = "YOLO26n_T2_ESP";
        cfg.engine          = EngineType::ESP_DL;
        cfg.espdl_partition = "model_yolo26";     // partitions.csv label
        cfg.tflite_data     = nullptr;
        cfg.tflite_size     = 0;
        cfg.arena_size      = 0;
        cfg.conf_threshold  = YOLO26ESP_CONF_THRESHOLD;
        cfg.iou_threshold   = YOLO26ESP_IOU_THRESHOLD;
        break;

    case ModelType::YOLO26N_T3_ESP:
        cfg.name            = "YOLO26n_T3_ESP";
        cfg.engine          = EngineType::ESP_DL;
        cfg.espdl_partition = "model_yolo26";     // Opción A: misma partición que T2
        cfg.tflite_data     = nullptr;
        cfg.tflite_size     = 0;
        cfg.arena_size      = 0;
        cfg.conf_threshold  = YOLO26T3ESP_CONF_THRESHOLD;
        cfg.iou_threshold   = YOLO26T3ESP_IOU_THRESHOLD;
        break;
    }

    return cfg;
}

// ═══════════════════════════════════════════════════════════════════════════
//  Inference engine factory
// ═══════════════════════════════════════════════════════════════════════════
static InferenceEngine* create_engine(EngineType type) {
    switch (type) {
    case EngineType::TFLITE_MICRO:
        return new TFLiteEngine();
    case EngineType::ESP_DL:
        return new EspDlEngine();
    }
    return nullptr;
}

// ═══════════════════════════════════════════════════════════════════════════
//  Postprocess dispatcher
// ═══════════════════════════════════════════════════════════════════════════
static DetectionResult run_postprocess(const InferenceEngine* engine,
                                       const ModelConfig& cfg)
{
#if DYNAMIC_THRESHOLDS
    // Read thresholds from atomics (set by web UI sliders)
    const float conf_thr = g_conf_threshold.load(std::memory_order_relaxed);
    const float iou_thr  = g_iou_threshold.load(std::memory_order_relaxed);
#else
    // Use compile-time fixed thresholds from ModelConfig
    const float conf_thr = cfg.conf_threshold;
    const float iou_thr  = cfg.iou_threshold;
#endif

    // For TFLite output — floats are already dequantized
    switch (cfg.type) {
    case ModelType::MOBILENET_SSD: {
        // 3 output tensors: [0]=(1,1470,4) box, [1]=(1,1470,5) cls, [2]=(1,1470,1) obj
        // Note: output order from TFLite may vary — we identify by shape
        const float* out0 = static_cast<const float*>(engine->get_output(0));
        const float* out1 = static_cast<const float*>(engine->get_output(1));
        const float* out2 = static_cast<const float*>(engine->get_output(2));

        // Identify which output is which by checking dimensions
        int dims0[4], dims1[4], dims2[4];
        int nd0, nd1, nd2;
        engine->get_output_shape(0, dims0, &nd0);
        engine->get_output_shape(1, dims1, &nd1);
        engine->get_output_shape(2, dims2, &nd2);

        // Assign by last dimension: 4=box, 5=cls, 1=obj
        const float* objectness   = nullptr;
        const float* class_probs  = nullptr;
        const float* bbox_preds   = nullptr;

        auto assign = [&](const float* ptr, int last_dim) {
            if (last_dim == 1)              objectness  = ptr;
            else if (last_dim == NUM_CLASSES) class_probs = ptr;
            else if (last_dim == 4)          bbox_preds  = ptr;
        };

        assign(out0, dims0[nd0 - 1]);
        assign(out1, dims1[nd1 - 1]);
        assign(out2, dims2[nd2 - 1]);

        if (objectness && class_probs && bbox_preds) {
            return postprocess_mobilenet(objectness, class_probs, bbox_preds,
                                         conf_thr, iou_thr);
        }
        ESP_LOGE(TAG, "No se pudieron identificar los tensores de salida MBNTv2");
        return DetectionResult{};
    }

    case ModelType::YOLO11N: {
        // Handle both float32 (hybrid) and int8 (fullint8) outputs
        if (engine->is_output_int8(0)) {
            // Full INT8: dequantize [1,9,1029] int8 → float
            const int8_t* raw_q = static_cast<const int8_t*>(engine->get_output(0));
            float scale = engine->get_output_scale(0);
            int32_t zp   = engine->get_output_zero_point(0);

            static float deq_buf[9 * 1029];  // Y11: 9 × 1029
            for (int i = 0; i < 9 * 1029; ++i) {
                deq_buf[i] = (static_cast<float>(raw_q[i]) - static_cast<float>(zp)) * scale;
            }
            return postprocess_yolo11(deq_buf, conf_thr, iou_thr);
        } else {
            const float* raw = static_cast<const float*>(engine->get_output(0));
            return postprocess_yolo11(raw, conf_thr, iou_thr);
        }
    }

    case ModelType::YOLO26N: {
        // Handle both float32 (hybrid) and int8 (fullint8) outputs
        if (engine->is_output_int8(0)) {
            // Full INT8 model: dequantize int8 output to float
            const int8_t* raw_q = static_cast<const int8_t*>(engine->get_output(0));
            float scale = engine->get_output_scale(0);
            int32_t zp   = engine->get_output_zero_point(0);

            static float deq_buf[300 * 6];  // Y26: 300 dets × 6 fields
            for (int i = 0; i < 300 * 6; ++i) {
                deq_buf[i] = (static_cast<float>(raw_q[i]) - static_cast<float>(zp)) * scale;
            }
            // Fullint8 output has normalised coordinates [0,1]
            return postprocess_yolo26(deq_buf, conf_thr, /*coords_normalized=*/true);
        } else {
            const float* raw = static_cast<const float*>(engine->get_output(0));
            return postprocess_yolo26(raw, conf_thr, /*coords_normalized=*/false);
        }
    }

    // ─── ESP-DL multi-output models ──────────────────────────────────
    case ModelType::ESPDET_PICO:
        return postprocess_espdet_espdl(engine, conf_thr, iou_thr);

    case ModelType::YOLO26N_ESP:
        return postprocess_yolo26_espdl(engine, conf_thr, iou_thr);

    case ModelType::YOLO26N_T3_ESP:
        return postprocess_yolo26_t3_espdl(engine, conf_thr, iou_thr);
    }

    return DetectionResult{};
}

// ═══════════════════════════════════════════════════════════════════════════
//  Inference task — pinned to Core 0
//
//  Two modes controlled by g_infer_mode (atomic, set via WebSocket):
//    CONTINUOUS  — capture → encode JPEG → preprocess → infer → broadcast
//    ON_DEMAND   — capture → encode JPEG (stream only);
//                  when g_infer_trigger is set: also preprocess → infer → send capture
// ═══════════════════════════════════════════════════════════════════════════
static void inference_task(void* param) {
    auto* engine = static_cast<InferenceEngine*>(param);
    ModelConfig cfg = make_model_config(static_cast<ModelType>(ACTIVE_MODEL_TYPE),
                                        static_cast<EngineType>(ACTIVE_ENGINE_TYPE));

    bool needs_float = false;
    bool needs_espdl_preprocess = (cfg.engine == EngineType::ESP_DL);

#if DYNAMIC_THRESHOLDS
    // Sync dynamic thresholds with the active model at startup
    g_conf_threshold.store(cfg.conf_threshold, std::memory_order_relaxed);
    g_iou_threshold.store(cfg.iou_threshold, std::memory_order_relaxed);
#endif

    // Determine initial model index from AVAILABLE_MODELS
    uint8_t current_model_idx = 0;
    for (int i = 0; i < NUM_AVAILABLE_MODELS; ++i) {
        if (AVAILABLE_MODELS[i].type == static_cast<ModelType>(ACTIVE_MODEL_TYPE)) {
            current_model_idx = static_cast<uint8_t>(i);
            break;
        }
    }

    ESP_LOGI(TAG, "═══════════════════════════════════════════════");
    ESP_LOGI(TAG, " Inference loop — modelo: %s", cfg.name);
    ESP_LOGI(TAG, " Engine:  %s", engine->runtime_name());
    ESP_LOGI(TAG, " Input:   %s", needs_float ? "float32" : "INT8");
    ESP_LOGI(TAG, " Core:    %d", xPortGetCoreID());
    ESP_LOGI(TAG, " Modo:    Ambos (continuous / on-demand via WS)");
    ESP_LOGI(TAG, "═══════════════════════════════════════════════");

    while (true) {        // ─── 0. Model hot-swap ─────────────────────────────────────────
        if (g_model_switch.load(std::memory_order_acquire)) {
            uint8_t next = g_next_model.load(std::memory_order_relaxed);
            uint32_t req_id = g_model_req_id.load(std::memory_order_relaxed);
            if (next < NUM_AVAILABLE_MODELS && next != current_model_idx) {
                ESP_LOGI(TAG, "🔄 Cambiando modelo %d → %d ...", current_model_idx, next);

                ModelConfig previous_cfg = cfg;
                ModelConfig next_cfg = make_model_config(AVAILABLE_MODELS[next].type,
                                                         AVAILABLE_MODELS[next].engine);

                esp_err_t r = engine_switch_via_ipc(engine, next_cfg, previous_cfg);
                if (r == ESP_OK) {
                    cfg = next_cfg;
                    current_model_idx = next;
                    needs_espdl_preprocess = (cfg.engine == EngineType::ESP_DL);
#if DYNAMIC_THRESHOLDS
                    g_conf_threshold.store(cfg.conf_threshold, std::memory_order_relaxed);
                    g_iou_threshold.store(cfg.iou_threshold, std::memory_order_relaxed);
#endif
                    ESP_LOGI(TAG, "✅ Modelo cambiado: %s (arena: %zu KB)",
                             cfg.name, engine->get_arena_used() / 1024);
                    webserver_notify_model_switch("done", true,
                                                  static_cast<int>(next),
                                                  static_cast<int>(current_model_idx),
                                                  cfg.name,
                                                  req_id,
                                                  nullptr);
                } else {
                    ESP_LOGE(TAG, "❌ Fallo init modelo %d: %s — rollback",
                             next, esp_err_to_name(r));
                    cfg = previous_cfg;
                    webserver_notify_model_switch("done", false,
                                                  static_cast<int>(next),
                                                  static_cast<int>(current_model_idx),
                                                  cfg.name,
                                                  req_id,
                                                  esp_err_to_name(r));
                }
            } else {
                webserver_notify_model_switch("done", true,
                                              static_cast<int>(next),
                                              static_cast<int>(current_model_idx),
                                              cfg.name,
                                              req_id,
                                              nullptr);
            }
            g_model_switch.store(false, std::memory_order_relaxed);
            g_model_req_id.store(0, std::memory_order_relaxed);
        }
        // ─── 1. Capture ──────────────────────────────────────────────
        metrics_frame_begin();

        camera_fb_t* fb = camera_capture();
        if (!fb) {
            ESP_LOGW(TAG, "Captura fallida, reintentando...");
            vTaskDelay(pdMS_TO_TICKS(100));
            continue;
        }

        // ─── 2. Encode JPEG from 224×224 center crop (stream) ─────
        crop_224(fb);
        uint8_t* stream_jpg = nullptr;
        size_t   stream_jpg_len = 0;
        bool jpg_ok = fmt2jpg(s_crop_rgb565,
                              INPUT_WIDTH * INPUT_HEIGHT * 2,
                              INPUT_WIDTH, INPUT_HEIGHT,
                              PIXFORMAT_RGB565, STREAM_JPEG_QUALITY,
                              &stream_jpg, &stream_jpg_len);

        // ─── 3. Check inference mode ─────────────────────────────────
        InferMode mode = g_infer_mode.load(std::memory_order_relaxed);
        bool triggered = g_infer_trigger.exchange(false, std::memory_order_relaxed);
        bool should_infer = (mode == InferMode::CONTINUOUS) || triggered;

        if (!should_infer) {
            // Stream-only: publish immediately (no bboxes to sync)
            if (jpg_ok && stream_jpg) {
                stream_buf_publish(stream_jpg, stream_jpg_len);
                free(stream_jpg);
            }
            camera_release_fb(fb);
            taskYIELD();
            continue;
        }

        // ─── 4. Encode high-quality JPEG for captured frame (on-demand) ─
        //  Uses same 224×224 crop (already in s_crop_rgb565 from step 2)
        uint8_t* capture_jpg = nullptr;
        size_t   capture_jpg_len = 0;
        if (triggered) {
            fmt2jpg(s_crop_rgb565,
                    INPUT_WIDTH * INPUT_HEIGHT * 2,
                    INPUT_WIDTH, INPUT_HEIGHT,
                    PIXFORMAT_RGB565, CAPTURE_JPEG_QUALITY,
                    &capture_jpg, &capture_jpg_len);
        }

        // ─── 5. Preprocess ──────────────────────────────────────────
        esp_err_t ret;

        if (needs_float) {
            float* input_f = image_preprocess_float(fb);
            camera_release_fb(fb);
            metrics_preprocess_end();

            if (!input_f) {
                ESP_LOGW(TAG, "Preprocesamiento float fallido");
                free(capture_jpg);
                free(stream_jpg);
                continue;
            }
            ret = engine->invoke_float(input_f);
        } else if (needs_espdl_preprocess) {
            int8_t* input_i = image_preprocess_espdl(fb);
            camera_release_fb(fb);
            metrics_preprocess_end();

            if (!input_i) {
                ESP_LOGW(TAG, "Preprocesamiento ESPDL fallido");
                free(capture_jpg);
                free(stream_jpg);
                continue;
            }
            ret = engine->invoke(input_i);
        } else {
            int8_t* input_i = image_preprocess(fb);
            camera_release_fb(fb);
            metrics_preprocess_end();

            if (!input_i) {
                ESP_LOGW(TAG, "Preprocesamiento INT8 fallido");
                free(capture_jpg);
                free(stream_jpg);
                continue;
            }
            ret = engine->invoke(input_i);
        }

        metrics_inference_end();

        if (ret != ESP_OK) {
            ESP_LOGE(TAG, "Inferencia fallida: %s", esp_err_to_name(ret));
            free(capture_jpg);
            free(stream_jpg);
            vTaskDelay(pdMS_TO_TICKS(500));
            continue;
        }

        // ─── 6. Postprocess ─────────────────────────────────────────
        DetectionResult dets = run_postprocess(engine, cfg);
        metrics_postprocess_end(dets.count);

        // ─── 7. Report ──────────────────────────────────────────────
        InferenceMetrics m = metrics_get();
        m.arena_used = engine->get_arena_used();
        m.model_name = cfg.name;
        m.model_idx  = current_model_idx;

        if (m.frame_id % METRICS_REPORT_INTERVAL == 0) {
            ESP_LOGI(TAG, "[#%lu] %s | %.1f ms (pre:%.1f inf:%.1f post:%.1f) | "
                          "%.1f FPS | %d dets | heap:%luK psram:%luK",
                     m.frame_id, cfg.name,
                     m.total_ms, m.preprocess_ms, m.inference_ms, m.postprocess_ms,
                     m.fps, dets.count,
                     m.heap_internal_free / 1024, m.psram_free / 1024);
        }

        // ─── 8. Send captured frame via WS binary (on-demand trigger) ─
        if (triggered && capture_jpg && capture_jpg_len > 0) {
            webserver_send_capture(capture_jpg, capture_jpg_len);
        }
        free(capture_jpg);

        // ─── 9. Broadcast metrics + detections via WS ───────────────
        webserver_broadcast(m, dets);

        // ─── 10. Publish stream frame AFTER broadcast ────────────────
        //  In continuous mode the browser receives bboxes (WS) and the
        //  MJPEG frame nearly simultaneously, keeping them in sync.
        if (jpg_ok && stream_jpg) {
            stream_buf_publish(stream_jpg, stream_jpg_len);
            free(stream_jpg);
        }

        taskYIELD();
    }
}

// ═══════════════════════════════════════════════════════════════════════════
//  app_main — called by ESP-IDF on boot
// ═══════════════════════════════════════════════════════════════════════════
extern "C" void app_main(void) {
    ESP_LOGI(TAG, "═══════════════════════════════════════════════════════════");
    ESP_LOGI(TAG, " TFM TinyML Detector — ESP32-S3 Object Detection");
    ESP_LOGI(TAG, " Build: %s %s", __DATE__, __TIME__);
    ESP_LOGI(TAG, "═══════════════════════════════════════════════════════════");

    // ─── Print heap info ─────────────────────────────────────────────
    ESP_LOGI(TAG, "Heap interno libre: %u KB",
             (unsigned)(heap_caps_get_free_size(MALLOC_CAP_INTERNAL) / 1024));
    ESP_LOGI(TAG, "PSRAM libre:        %u KB",
             (unsigned)(heap_caps_get_free_size(MALLOC_CAP_SPIRAM) / 1024));

    // ─── 1. Init metrics ─────────────────────────────────────────────
    ESP_ERROR_CHECK(metrics_init());

    // ─── 2. Init camera ──────────────────────────────────────────────
    ESP_ERROR_CHECK(camera_init());

    // ─── 3. Init image preprocessing ─────────────────────────────────
    ESP_ERROR_CHECK(image_proc_init());

    // ─── 4. Init postprocessing ──────────────────────────────────────
    ESP_ERROR_CHECK(postprocess_init());

    // ─── 4b. Init stream buffer (JPEG shared buffer for MJPEG) ───────
    ESP_ERROR_CHECK(stream_buf_init());

    // ─── 4c. Allocate 224×224 crop buffer in PSRAM ────────────────────
    s_crop_rgb565 = static_cast<uint8_t*>(
        heap_caps_malloc(INPUT_WIDTH * INPUT_HEIGHT * 2, MALLOC_CAP_SPIRAM));
    if (!s_crop_rgb565) {
        ESP_LOGE(TAG, "No se pudo asignar crop buffer (%d KB en PSRAM)",
                 INPUT_WIDTH * INPUT_HEIGHT * 2 / 1024);
        return;
    }
    ESP_LOGI(TAG, "✅ Crop buffer 224×224 asignado (%d KB PSRAM)",
             INPUT_WIDTH * INPUT_HEIGHT * 2 / 1024);

    // ─── 5. Create & init inference engine ───────────────────────────
    ModelConfig cfg = make_model_config(static_cast<ModelType>(ACTIVE_MODEL_TYPE),
                                        static_cast<EngineType>(ACTIVE_ENGINE_TYPE));

    ESP_LOGI(TAG, "Cargando modelo: %s (%s)",
             cfg.name, ACTIVE_ENGINE_TYPE == EngineType::TFLITE_MICRO
                       ? "TFLite Micro" : "ESP-DL");
    if (cfg.engine == EngineType::TFLITE_MICRO) {
        ESP_LOGI(TAG, "   TFLite size: %zu KB", cfg.tflite_size / 1024);
        ESP_LOGI(TAG, "   Arena estimado: %d KB", cfg.arena_size / 1024);
    } else {
        ESP_LOGI(TAG, "   Partición ESPDL: %s", cfg.espdl_partition ? cfg.espdl_partition : "(null)");
    }

    InferenceEngine* engine = create_engine(static_cast<EngineType>(ACTIVE_ENGINE_TYPE));
    if (!engine) {
        ESP_LOGE(TAG, "No se pudo crear el motor de inferencia");
        return;
    }

    esp_err_t ret = engine->init(&cfg);
    if (ret != ESP_OK) {
        ESP_LOGE(TAG, "Error inicializando motor: %s", esp_err_to_name(ret));
        delete engine;
        return;
    }

    ESP_LOGI(TAG, "Arena usado: %zu KB", engine->get_arena_used() / 1024);

    // ─── 6. Start WiFi STA ────────────────────────────────────────────
    ESP_ERROR_CHECK(wifi_init_sta());

    // ─── 7. Start Web Server ─────────────────────────────────────────
    ESP_ERROR_CHECK(webserver_start());
    ESP_LOGI(TAG, "Dashboard: http://%s/", wifi_get_ip());

    // ─── 8. Launch inference task on Core 0 ──────────────────────────
    ESP_LOGI(TAG, "Lanzando tarea de inferencia en Core %d...", INFERENCE_TASK_CORE);

    // Allocate task stack from PSRAM — internal heap is too fragmented
    // after ESP-DL model load + WiFi init for a contiguous 32 KB block.
    BaseType_t task_ret = xTaskCreatePinnedToCoreWithCaps(
        inference_task,
        "inference",
        INFERENCE_TASK_STACK,
        engine,
        INFERENCE_TASK_PRIORITY,
        nullptr,
        INFERENCE_TASK_CORE,
        MALLOC_CAP_SPIRAM
    );

    if (task_ret != pdPASS) {
        ESP_LOGE(TAG, "No se pudo crear la tarea de inferencia (heap interno: %u KB, PSRAM: %u KB)",
                 (unsigned)(heap_caps_get_free_size(MALLOC_CAP_INTERNAL) / 1024),
                 (unsigned)(heap_caps_get_free_size(MALLOC_CAP_SPIRAM) / 1024));
        engine->deinit();
        delete engine;
        return;
    }

    ESP_LOGI(TAG, "═══════════════════════════════════════════════════════════");
    ESP_LOGI(TAG, " ✅ Sistema iniciado correctamente");
    ESP_LOGI(TAG, " 🌐 Dashboard: http://%s/", wifi_get_ip());
    ESP_LOGI(TAG, "═══════════════════════════════════════════════════════════");
}
